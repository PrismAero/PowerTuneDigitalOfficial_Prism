## yocto/meta-powertune/conf/layer.conf
```bitbake
# meta-powertune layer configuration
BBPATH .= ":${LAYERDIR}"

BBFILES += " \
    ${LAYERDIR}/recipes-*/*/*.bb \
    ${LAYERDIR}/recipes-*/*/*.bbappend \
"

BBFILE_COLLECTIONS += "meta-powertune"
BBFILE_PATTERN_meta-powertune = "^${LAYERDIR}/"
BBFILE_PRIORITY_meta-powertune = "10"

LAYERDEPENDS_meta-powertune = "core qt6-layer raspberrypi"
LAYERSERIES_COMPAT_meta-powertune = "scarthgap"
```
